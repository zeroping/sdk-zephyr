## drivers/sensor/bq28550/Kconfig
```kconfig
# Copyright (c) 2020 Linumiz
#
# SPDX-License-Identifier: Apache-2.0

config BQ28550
	bool "BQ28550 Fuel Gauge"
	depends on I2C
	help
	  Enable I2C-based driver for BQ28550 Fuel Gauge.
```

## dts/bindings/sensor/ti,bq28550.yaml
```yaml
#
# Copyright (c) 2020 Linumiz
#
# SPDX-License-Identifier: Apache-2.0
#

description: Texas Instruments bq28550 Fuel Gauge

compatible: "ti,bq28550"

include: i2c-device.yaml
```
